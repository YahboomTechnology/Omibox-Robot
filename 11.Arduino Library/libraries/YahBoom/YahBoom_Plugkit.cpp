/*****************
YahBoom_Plugkit.cpp
******************/

#include"YahBoom_Plugkit.h"
#include "avr/pgmspace.h"
//PROGMEN类型用到上面的头文件
dht11 DHT11;

Adafruit_SSD1306 display(OLED_RESET);

#define G5 392//小字组G
#define A6 440//小字组A
#define B7 494//小字组B
#define c1 525//小字一组c即中央c
#define d2 587//小字一组d
#define e3 659//小字一组e
#define f4 698//小字一组f
#define g5 784//小字一组g
#define a6 880//小字一组a
#define b7 988//小字一组b
#define C1 1047//小字二组C
#define D2 1175//小字二组D
#define E3 1319//小字二组E
#define F4 1397//小字二组F
#define GG5 1568//小字二组G
#define AA6 1769//小字二组A

enum enMusic
	{
		enBirthday=1,
		Childhood=2,
		Fenshuajiang=3,
		Huanlesong=4,
		Shishangzhiyoumamahao=5,
		Rangwomendangqishuangjiang=6,
		Liangzhilaohu=7,
		Xinnianhao=8,
		Xiaoxingxing=9,
		Yuemayangbian=10,
		Wanghouyusheng=11,   
		Guangdongaiqinggushi=12 
	};
	
enum enstaticPicture
	{
		encircle=1,
		triangle=2,
		rect=3,
		roundrect=4,
		heart=5,
		star=6,
		right2=7,
		error=8,
		house=9,
		boat=10,
		umbrella=11,
		smile=12,
		cry=13,
		note=14,
		xhr=15,
		pkq=16,
		hmbb=17,
		xzpq=18
	}; 

enum endynamicPicture
	{
		enfillrect=1,
		filltriangle=2,
		fillroundrect=3,
		beatingheart=4,
		babysbreath=5,
		geometryanimation=6
	}; 

enum enstartscroll
	{
		enstatic=1,
		left=2,
		right=3,
		diagright=4,
		diagleft=5,
	};

//显示一个心形
const static uint8_t PROGMEM Heart_16x16[]=
{
  B00000000, B00000000,
  B00000000, B00000000,
  B00000000, B00000000,
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  B00000000, B00000000 
};

//显示一个星形
const static uint8_t PROGMEM star_16x16[]=
{0x00,0x00,0x00,0x00,0x01,0x00,0x01,0x00,0x03,0x80,0x03,0x80,0x03,0x80,0x1F,0xF0,
0x7F,0xFC,0x1F,0xF0,0x03,0x80,0x03,0x80,0x03,0x80,0x01,0x00,0x01,0x00,0x00,0x00};/*"C:\Users\Administrator\Desktop\闪光.bmp",0*/

static const unsigned char PROGMEM heart1[] =
{0x01,0xE0,0x00,0xF0,0x00,0x0F,0xFC,0x03,0xFE,0x00,0x1F,0xFE,0x0F,0xFF,0x00,0x3E,
0x3F,0x1F,0x8F,0x80,0x78,0x07,0xBC,0x03,0xC0,0x70,0x03,0xF8,0x01,0xC0,0xF0,0x01,
0xF0,0x01,0xE0,0xE0,0x00,0xF0,0x00,0xE0,0xE0,0x00,0xE0,0x00,0xE0,0xE0,0x00,0x00,
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0x00,0x00,0x00,0x03,0xF8,0x00,0x00,0x00,0x00,0xE0,0x00,0x00};/*"C:\Users\Administrator\Desktop\桃心1.bmp",0*/

static const unsigned char PROGMEM star1[] =
{0x00,0x00,0x60,0x00,0x00,0x00,0x00,0xF0,0x00,0x00,0x00,0x00,0xF0,0x00,0x00,0x00,
0x00,0xF0,0x00,0x00,0x00,0x01,0xF8,0x00,0x00,0x00,0x01,0xF8,0x00,0x00,0x00,0x03,
0xFC,0x00,0x00,0x00,0x03,0x9C,0x00,0x00,0x00,0x03,0x9C,0x00,0x00,0x00,0x07,0x0E,
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0xF8,0x00,0x01,0xF8,0x01,0xFC,0x00,0x03,0xE0,0x00,0x7C,0x00,0x01,0x80,0x00,0x18,
0x00};/*"C:\Users\Administrator\Desktop\星星1.bmp",0*/

static const unsigned char PROGMEM right1[] =
{0x00,0x00,0x00,0x00,0x00,0x00,0x00,0x00,0x00,0x00,0x00,0x00,0x00,0x00,0x00,0x00,
0x00,0xE0,0x00,0x00,0x00,0x00,0x01,0xE0,0x00,0x00,0x00,0x00,0x03,0xE0,0x00,0x00,
0x00,0x00,0x07,0xC0,0x00,0x00,0x00,0x00,0x0F,0x80,0x00,0x00,0x00,0x00,0x1F,0x00,
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0x80,0x00,0x00,0x00,0x00,0x00,0x00,0x00,0x00,0x00};/*"C:\Users\Administrator\Desktop\对1.bmp",0*/


static const unsigned char PROGMEM error1[] =
{0xF8,0x00,0x00,0x03,0xE0,0x7C,0x00,0x00,0x07,0xC0,0x3E,0x00,0x00,0x0F,0x80,0x1F,
0x00,0x00,0x1F,0x00,0x0F,0x80,0x00,0x3E,0x00,0x07,0xC0,0x00,0x7C,0x00,0x03,0xE0,
0x00,0xF8,0x00,0x01,0xF0,0x01,0xF0,0x00,0x00,0xF8,0x03,0xE0,0x00,0x00,0x7C,0x07,
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0x80,0x7C,0x00,0x00,0x07,0xC0,0xF8,0x00,0x00,0x03,0xE0,0xF0,0x00,0x00,0x01,0xF0};/*"C:\Users\Administrator\Desktop\错1.bmp",0*/

static const unsigned char PROGMEM house1[] =
{0x00,0x00,0x00,0x00,0x3D,0x00,0x00,0x00,0x00,0x00,0x00,0x00,0x00,0x00,0xF3,0xC0,
0x00,0x00,0x00,0x00,0x00,0x00,0x00,0x03,0xC0,0xF0,0x00,0x00,0x00,0x00,0x00,0x00,
0x00,0x0F,0x00,0x3C,0x00,0x00,0x00,0x00,0x00,0x00,0x00,0x3C,0x00,0x0F,0x00,0x00,
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0x7F,0xC0,0x08,0x00,0x00,0x80,0x40,0x00,0x07,0xFF,0xFF,0xFF,0xF8,0x00,0x00,0x40};/*"C:\Users\Administrator\Desktop\房子1.bmp",0*/

static const unsigned char PROGMEM boat1[] =
{0x00,0x00,0x00,0x00,0x00,0x00,0x00,0x00,0x00,0x00,0x00,0x00,0x00,0x00,0x00,0x00,
0x00,0x00,0x00,0x00,0x00,0x00,0x00,0x00,0x00,0x00,0x00,0x00,0x00,0x00,0x03,0xFF,
0xE0,0x00,0x03,0xFF,0xC0,0x00,0x00,0x00,0x00,0x00,0x00,0x02,0x00,0x20,0x00,0x02,
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0x00,0x00,0x00,0x00,0x00,0x00,0x00,0x00,0x00,0x00,0x00,0x00,0x00,0x00,0x00,0x00};/*"C:\Users\Administrator\Desktop\小船1.bmp",0*/

static const unsigned char PROGMEM umbrella1[] =
{0x00,0x00,0x00,0x3C,0x00,0x00,0x00,0x00,0x00,0x00,0x00,0x23,0x00,0x00,0x00,0x00,
0x00,0x00,0x00,0x20,0x80,0x00,0x00,0x00,0x00,0x00,0x00,0x20,0x40,0x00,0x00,0x00,
0x01,0xC0,0x00,0x20,0x20,0x00,0x00,0x00,0x0E,0x30,0x00,0x20,0x20,0x00,0x00,0x00,
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0x00,0x00,0x00,0x00,0x00,0x00,0x3E,0x00,0x00,0x00,0x00,0x00,0x00,0x00,0x03,0x00};/*"C:\Users\Administrator\Desktop\雨伞1.bmp",0*/

static const unsigned char PROGMEM smile1[] =
{0x00,0x07,0xF8,0x00,0x00,0x00,0x38,0x07,0x00,0x00,0x00,0xC0,0x00,0xC0,0x00,0x03,
0x00,0x00,0x30,0x00,0x04,0x00,0x00,0x08,0x00,0x08,0x00,0x00,0x04,0x00,0x10,0x00,
0x00,0x02,0x00,0x20,0x40,0x01,0x01,0x00,0x20,0x40,0x01,0x01,0x00,0x40,0xA0,0x02,
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0x00,0x00,0x07,0xF8,0x00,0x00};/*"C:\Users\Administrator\Desktop\笑脸.bmp",0*/


static const unsigned char PROGMEM cry1[] =
{0x00,0x07,0xF8,0x00,0x00,0x00,0x38,0x07,0x00,0x00,0x00,0xC0,0x00,0xC0,0x00,0x03,
0x00,0x00,0x30,0x00,0x04,0x00,0x00,0x08,0x00,0x08,0x00,0x00,0x04,0x00,0x10,0x00,
0x00,0x02,0x00,0x20,0x40,0x01,0x01,0x00,0x20,0x40,0x01,0x01,0x00,0x40,0xA0,0x02,
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0x00,0x00,0x07,0xF8,0x00,0x00};/*"C:\Users\Administrator\Desktop\哭脸1.bmp",0*/

static const unsigned char PROGMEM note1[] =
{0x00,0x00,0x00,0x00,0x60,0x00,0x00,0x00,0x07,0xA0,0x00,0x00,0x00,0x38,0x20,0x00,
0x00,0x01,0xC0,0x20,0x00,0x00,0x1E,0x00,0x20,0x00,0x00,0xE0,0x0E,0x20,0x00,0x07,
0x00,0xF2,0x20,0x00,0x78,0x07,0x02,0x20,0x01,0x80,0x38,0x02,0x20,0x01,0x03,0xC0,
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0xC0,0xC0,0x18,0x01,0x03,0x80,0x70,0x60,0x01,0x8E,0x00,0x3F,0x80,0x00,0xF8,0x00};/*"C:\Users\Administrator\Desktop\音符.bmp",0*/

static const unsigned char PROGMEM xhr1[] =
{0x00,0x00,0x00,0x00,0x00,0x00,0x00,0x00,0x00,0x00,0x00,0x00,0x00,0x00,0x3C,0x00,
0x00,0x00,0x00,0x00,0xFF,0xF0,0x00,0x00,0x00,0x01,0xFF,0xFE,0x00,0x00,0x00,0x03,
0xFF,0xFF,0x00,0x00,0x00,0x06,0xFF,0xFF,0x80,0x00,0x00,0x07,0xF9,0xBF,0x80,0x00,
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0x87,0xFF,0xE0,0x00,0x00,0x3F,0xC3,0xFF,0xFF,0x80,0x00,0x30,0x81,0xFF,0xFF,0x80};/*"C:\Users\Administrator\Desktop\小黄人.bmp",0*/

static const unsigned char PROGMEM pkq1[] =
{0x00,0x00,0x00,0x00,0x01,0x00,0x00,0x00,0x03,0x80,0x00,0x00,0x03,0x80,0x00,0x00,
0x03,0xC0,0x00,0xF0,0x03,0x40,0x07,0xF0,0x03,0x40,0x1C,0xE0,0x02,0x60,0x30,0xC0,
0x03,0x6F,0xE3,0x98,0x03,0x3C,0x1E,0x78,0x01,0x70,0x19,0xCC,0x01,0xC0,0x7B,0x0C,
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0x00,0x01,0xCF,0xFC,0x00,0x00,0xF9,0xFC,0x00,0x00,0x70,0x00,0x00,0x00,0x70,0x00};/*"C:\Users\Administrator\Desktop\pkq.bmp",0*/

static const unsigned char PROGMEM hmbb1[] =
{0x00,0x00,0x00,0x00,0x00,0x00,0x00,0x00,0x00,0x00,0x00,0x00,0x00,0x00,0x00,0x00,
0x00,0x00,0x00,0x00,0x00,0x00,0x00,0x00,0x00,0x00,0x00,0x00,0x00,0x00,0x00,0x1F,
0xFF,0xFF,0xC0,0x00,0x00,0x3F,0xFF,0xFF,0xE0,0x00,0x00,0x30,0x00,0x00,0x60,0x00,
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0xFF,0xFF,0x00,0x00,0x00,0x03,0x07,0x03,0x00,0x00,0x00,0x03,0x83,0x03,0x00,0x00};/*"C:\Users\Administrator\Desktop\海绵宝宝.bmp",0*/

static const unsigned char PROGMEM xzpq1[] =
{0x08,0x00,0x1F,0x00,0x09,0x00,0x3F,0x80,0x7F,0x00,0x3F,0x80,0x33,0x00,0x3F,0x80,
0x31,0x80,0x00,0x00,0x73,0x00,0x00,0x00,0x1E,0x00,0x7E,0x00,0x0D,0x80,0xDB,0x80,
0x08,0x70,0xC0,0x80,0x01,0xFF,0xC3,0x80,0x01,0xFF,0xFF,0x80,0x01,0xFF,0xFE,0x00,
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0x0F,0xFF,0xFC,0x00,0x0F,0xFD,0xFC,0x00,0x0F,0xFD,0xFF,0x80,0x07,0xC0,0xFF,0x80};/*"C:\Users\Administrator\Desktop\小猪佩奇.bmp",0*/

static const unsigned char PROGMEM zi1[] =
{0x00,0x00,0x01,0x00,0x01,0x00,0x02,0x00,0x02,0x60,0x0D,0xB0,0x08,0x10,0x08,0x10,
0x07,0x10,0x08,0x10,0x07,0x90,0x08,0x10,0x08,0xD0,0x07,0x30,0x00,0x20,0x00,0x00};/*"自",0*/

static const unsigned char PROGMEM din2[] =
{0x00,0x00,0x00,0x00,0x01,0x00,0x01,0x00,0x11,0xF8,0x1E,0x10,0x10,0x60,0x07,0x80,
0x01,0x00,0x0D,0xE0,0x09,0x00,0x0F,0x00,0x11,0x00,0x20,0xF0,0x00,0x3C,0x00,0x00};/*"定",1*/

static const unsigned char PROGMEM yi3[] =
{0x00,0x00,0x00,0x00,0x00,0x00,0x00,0x60,0x02,0x40,0x02,0x40,0x08,0x80,0x04,0x80,
0x02,0x80,0x01,0x00,0x03,0x80,0x06,0xC0,0x08,0x60,0x10,0x3C,0x00,0x00,0x00,0x00};/*"义",2*/

uint16_t val_R = 0;
uint16_t val_G = 0;
uint16_t val_B = 0;

int nFrames = 36;

const PROGMEM  int BIrthday[25][2]
{
	{G5,2},{A6,2},{G5,2},{c1,2},{B7,4},
	{G5,2},{A6,2},{G5,2},{d2,2},{c1,4},
	{G5,2},{g5,2},{e3,2},{c1,2},{B7,2},{A6,2},
	{f4,2},{e3,2},{c1,2},{d2,2},{c1,2}
};

const PROGMEM  int CHildhood[80][2]
{
	{e3,1},{g5,1},{g5,2},{e3,1},{a6,1},{a6,1},{b7,1},{a6,1},{a6,1},{a6,1},{g5,1},{C1,2},{C1,1},{C1,1},{C1,1},{a6,1},{C1,1},{a6,1},{g5,8},
	{0,2},{e3,1},{g5,1},{g5,2},{e3,1},{a6,1},{a6,1},{b7,1},{a6,1},{a6,1},{a6,1},{g5,1},{C1,2},{C1,1},{C1,1},{C1,1},{a6,1},{a6,1},{C1,1},{D2,8},
	{GG5,1},{GG5,2},{GG5,2},{GG5,1},{E3,1},{D2,1},{C1,1},{C1,2},{a6,2},{C1,1},{a6,1},{C1,1},{D2,1},{D2,1},{D2,1},{D2,1},{C1,1},{E3,1},{D2,1},{D2,8},	
	{E3,1},{E3,2},{E3,1},{E3,1},{D2,1},{D2,2},{C1,1},{C1,2},{C1,1},{D2,1},{C1,1},{a6,1},{g5,1},{g5,1},{g5,2},{g5,1},{a6,1},{g5,1},{D2,1},{E3,1},{C1,8}
};

const PROGMEM  int FEnshuajiang[60][2]
{
	{g5,1},{e3,1},{g5,1},{e3,1},{g5,1},{e3,1},{c1,2},
	{d2,1},{f4,1},{e3,1},{d2,1},{g5,4},
	{g5,1},{e3,1},{g5,1},{e3,1},{g5,1},{e3,1},{c1,2},
	{d2,1},{f4,1},{e3,1},{d2,1},{c1,4},
	{d2,1},{d2,1},{f4,1},{f4,1},{e3,1},{c1,1},{g5,2},
	{d2,1},{f4,1},{e3,1},{d2,1},{g5,4},
	{g5,1},{e3,1},{g5,1},{e3,1},{g5,1},{e3,1},{c1,2},
	{d2,1},{f4,1},{e3,1},{d2,1},{c1,2}
};

const PROGMEM  int HUanlesong[70][2]
{
	{e3,2},{e3,2},{f4,2},{g5,2},{g5,2},{f4,2},{e3,2},{d2,2},{c1,2},{c1,2},{d2,2},{e3,2},{e3,3},{d2,1},{d2,4},
	{e3,2},{e3,2},{f4,2},{g5,2},{g5,2},{f4,2},{e3,2},{d2,2},{c1,2},{c1,2},{d2,2},{e3,2},{d2,3},{c1,1},{c1,4},
	{d2,2},{d2,2},{e3,2},{c1,2},{d2,2},{e3,1},{f4,1},{e3,2},{c1,2},
	{d2,2},{e3,1},{f4,1},{e3,2},{d2,2},{c1,2},{d2,2},{G5,2},
	{e3,2},{e3,2},{f4,2},{g5,2},{g5,2},{f4,2},{e3,2},{d2,2},{c1,2},{c1,2},{d2,2},{e3,2},{d2,3},{c1,1},{c1,4},
};
  
const PROGMEM  int WAnghouyusheng[75][2]
{
	{G5,1},{e3,1},{e3,2},{e3,1},{d2,2},{c1,2},{B7,1},{c1,2},{G5,13},
	{G5,1},{e3,1},{e3,2},{e3,1},{d2,2},{c1,2},{B7,2},{G5,2},{e3,4},
	{e3,1},{d2,1},{c1,1},{d2,9},{c1,1},{G5,2},{A6,2},{B7,2},{c1,1},{c1,5},
	{A6,1},{e3,1},{c1,1},{d2,1},{d2,5},{d2,1},{c1,1},{d2,1},{c1,5},{c1,2},{e3,2},{g5,2},
	{a6,8},{C1,2},{b7,2},{g5,2},{e3,8},{e3,2},{g5,2},{e3,2},{c1,8},{d2,1},{c1,2},{B7,2},{c1,1},{A6,1},
	{A6,7},{A6,2},{c1,2},{e3,2},{a6,4},{b7,1},{C1,1},{D2,2},{C1,1},{b7,3},{g5,10},{g5,2},{f4,2},{e3,2},
	{f4,8},{e3,6},{B7,1},{c1,17}
};
  
const PROGMEM  int YUemayangbian[48][2]
{
	{g5,2},{g5,2},{a6,1},{C1,1},{C1,2},{E3,1},{E3,1},{GG5,1},{AA6,1},{GG5,4},
	{AA6,3},{AA6,1},{GG5,1},{AA6,1},{E3,2},{D2,1},{E3,1},{GG5,1},{AA6,1},{C1,4},
	{a6,1},{a6,1},{a6,1},{g5,1},{a6,1},{C1,1},{0,2},{E3,1},{E3,1},{E3,1},{D2,1},{C1,1},{D2,1},{0,2},
	{GG5,1},{GG5,1},{GG5,1},{E3,1},{AA6,1},{E3,1},{0,2},{D2,1},{D2,1},{D2,1},{C1,1},{E3,1},{GG5,1},	
};

const PROGMEM  int GUangdongaiqinggushi[39][2]
{
	{e3,1},{g5,1},{a6,1},{a6,1},{a6,1},{a6,1},{a6,1},{g5,1},{g5,1},{d2,1},{d2,3},{d2,1},{c1,1},{d2,1},{c1,1},{d2,1},
	{g5,1},{g5,1},{g5,1},{g5,1},{g5,1},{e3,1},{d2,1},{c1,1},{c1,2},
	{e3,1},{g5,1},{a6,1},{a6,1},{a6,1},{a6,1},{g5,2},{a6,1},{d2,1},{d2,4},{c1,2},{d2,1},{e3,13},	
};

const PROGMEM  int SHishangzhiyoumamahao[34][2]
{
	{a6,6},{g5,2},{e3,4},{g5,4},{C1,4},{a6,2},{g5,2},{a6,8},
	{e3,4},{g5,2},{a6,2},{g5,4},{e3,2},{d2,2},{c1,2},{A6,2},{g5,2},{e3,2},{d2,8},	
	{d2,6},{e3,2},{g5,4},{g5,2},{a6,2},{e3,4},{d2,4},{c1,8},
	{g5,6},{e3,2},{d2,2},{c1,2},{A6,2},{c1,2},{G5,8}
};

const PROGMEM  int RAngwomendangqishuangjiang[67][2]
{
	{0,2},{A6,2},{c1,2},{d2,2},{e3,6},{g5,2},{e3,2},{c1,2},{d2,4},{A6,8},
	{0,2},{c1,2},{d2,2},{e3,2},{g5,6},{g5,2},{a6,4},{d2,4},{e3,12},
	{e3,2},{g5,2},{a6,8},{g5,6},{a6,2},{C1,2},{b7,1},{a6,1},{g5,2},{a6,2},{e3,4},
	{c1,2},{d2,2},{e3,6},{g5,2},{c1,4},{A6,4},{c1,2},{d2,2},{e3,2},{a6,2},{g5,12},{0,4},
	{e3,8},{a6,6},{a6,2},{g5,2},{f4,2},{e3,4},{d2,8},{e3,6},{g5,2},{A6,2},{c1,2},{d2,4},
	{0,4},{c1,2},{d2,2},{e3,4},{g5,3},{g5,1},{a6,4},{C1,4},{b7,2},{a6,2},{g5,2},{e3,2},{a6,12}
};

const PROGMEM  int XInnianhao[30][2]
{
	{c1,2},{c1,2},{c1,4},{G5,4},{e3,2},{e3,2},{e3,4},{c1,4},
	{c1,2},{e3,2},{g5,4},{g5,4},{f4,2},{e3,2},{d2,8},
	{d2,2},{e3,2},{f4,4},{f4,4},{e3,2},{d2,2},{e3,4},{c1,4},
	{c1,2},{e3,2},{d2,4},{G5,4},{B7,2},{d2,2},{c1,8}
};

const PROGMEM  int XIaoxingxing[42][2]
{
	{c1,2},{c1,2},{g5,2},{g5,2},{a6,2},{a6,2},{g5,4},
	{f4,2},{f4,2},{e3,2},{e3,2},{d2,2},{d2,2},{c1,4},
	{g5,2},{g5,2},{f4,2},{f4,2},{e3,2},{e3,2},{d2,4},
	{g5,2},{g5,2},{f4,2},{f4,2},{e3,2},{e3,2},{d2,4},
	{c1,2},{c1,2},{g5,2},{g5,2},{a6,2},{a6,2},{g5,4},
	{f4,2},{f4,2},{e3,2},{e3,2},{d2,2},{d2,2},{c1,4},
};

const PROGMEM  int LIangzhilaohu[32][2]
{
	{c1,2},{d2,2},{e3,2},{c1,2},{c1,2},{d2,2},{e3,2},{c1,2},
	{e3,2},{f4,2},{g5,4},{e3,2},{f4,2},{g5,4},
	{g5,1},{a6,1},{g5,1},{f4,1},{e3,2},{c1,2},{g5,1},{a6,1},{g5,1},{f4,1},{e3,2},{c1,2},
	{d2,2},{G5,2},{c1,4},{d2,2},{G5,2},{c1,4}
};

/* #define INPUT 0x0 #define OUTPUT 0x1 #define INPUT_PULLUP 0x2 */ 
/*****************************************************************/ 
/*RGB灯模块*/ 
/*****************************************************************/
YahBoom_Plugkit_RGB::YahBoom_Plugkit_RGB(byte pin1, byte pin2, byte pin3, byte PinMode)   //构造函数 
{ 
	pinNameR = pin1;   
	pinNameG = pin2; 
	pinNameB = pin3;
	pinMode(pinNameR, PinMode);
	pinMode(pinNameG, PinMode);
	pinMode(pinNameB, PinMode);
	digitalWrite(pinNameR, LOW);
	digitalWrite(pinNameG, LOW);
	digitalWrite(pinNameB, LOW); 
}

YahBoom_Plugkit_RGB::~YahBoom_Plugkit_RGB()
{

} 

//关闭RGB灯
void YahBoom_Plugkit_RGB::RGB_OFF()
{
	digitalWrite(pinNameR, LOW);
	digitalWrite(pinNameG, LOW);
	digitalWrite(pinNameB, LOW);
}

//控制RGB灯颜色
void YahBoom_Plugkit_RGB::RGB_Control(int pinR_OnOff, int pinG_OnOff, int pinB_OnOff)
{ 
	digitalWrite(pinNameR, pinR_OnOff);
	digitalWrite(pinNameG, pinG_OnOff);
	digitalWrite(pinNameB, pinB_OnOff);
}

//控制RGB灯的颜色值
void YahBoom_Plugkit_RGB::RGB_Contrl_PWM(int pinRValue, int pinGValue, int pinBValue)
{
	analogWrite(pinNameR, pinRValue);
	analogWrite(pinNameG, pinGValue);
	analogWrite(pinNameB, pinBValue);
}


/*****************************************************************/
/*板载蜂鸣器*/ 
/*****************************************************************/ 
YahBoom_Plugkit_Buzzer::YahBoom_Plugkit_Buzzer(byte pinname)
{
	pin = pinname;
}

YahBoom_Plugkit_Buzzer::~YahBoom_Plugkit_Buzzer()
{
	pinMode(pin, INPUT);
} 

void YahBoom_Plugkit_Buzzer::setBuzzer_Tone(uint16_t frequency, uint32_t duration)
{
	int period = 1000000L / frequency;//1000000L
  	int pulse = period / 2;
	pinMode(pin, OUTPUT);
  	for (long i = 0; i < duration * 200000L; i += period) 
  	{
		digitalWrite(pin, 1);
    	delayMicroseconds(pulse);
    	digitalWrite(pin, 0);
    	delayMicroseconds(pulse);
  	}
  	if(frequency==0)
  	delay(230*duration);	
	delay(20);
}

void YahBoom_Plugkit_Buzzer::birthday()
{
	int j;
	for(j=0;j<21;j++)
	{
		setBuzzer_Tone(pgm_read_word_near(&BIrthday[j][0]), pgm_read_word_near(&BIrthday[j][1]));	
	}
}

void YahBoom_Plugkit_Buzzer::childhood()
{
	int j;
	for(j=0;j<80;j++)
	{
		setBuzzer_Tone(pgm_read_word_near(&CHildhood[j][0]), pgm_read_word_near(&CHildhood[j][1]));	
	}
}

void YahBoom_Plugkit_Buzzer::fenshuajiang()
{
	int j;
	for(j=0;j<48;j++)
	{
		setBuzzer_Tone(pgm_read_word_near(&FEnshuajiang[j][0]), pgm_read_word_near(&FEnshuajiang[j][1]));	
	}
}

void YahBoom_Plugkit_Buzzer::wanghouyusheng()
{
	int j;
	for(j=0;j<75;j++)
	{
		setBuzzer_Tone(pgm_read_word_near(&WAnghouyusheng[j][0]), pgm_read_word_near(&WAnghouyusheng[j][1]));	
	}
}

void YahBoom_Plugkit_Buzzer::huanlesong()
{
	int j;
	for(j=0;j<70;j++)
	{
		setBuzzer_Tone(pgm_read_word_near(&HUanlesong[j][0]), pgm_read_word_near(&HUanlesong[j][1]));	
	}
}

void YahBoom_Plugkit_Buzzer::yuemayangbian()
{
	int j;
	for(j=0;j<48;j++)
	{
		setBuzzer_Tone(pgm_read_word_near(&YUemayangbian[j][0]), pgm_read_word_near(&YUemayangbian[j][1]));	
	}
}

void YahBoom_Plugkit_Buzzer::guangdongaiqinggushi()
{
	int j;
	for(j=0;j<39;j++)
	{
		setBuzzer_Tone(pgm_read_word_near(&GUangdongaiqinggushi[j][0]), pgm_read_word_near(&GUangdongaiqinggushi[j][1]));	
	}
}

void YahBoom_Plugkit_Buzzer::shishangzhiyoumamahao()
{
	int j;
	for(j=0;j<34;j++)
	{
		setBuzzer_Tone(pgm_read_word_near(&SHishangzhiyoumamahao[j][0]), pgm_read_word_near(&SHishangzhiyoumamahao[j][1]));	
	}
}

void YahBoom_Plugkit_Buzzer::rangwomendangqishuangjiang()
{
	int j;
	for(j=0;j<67;j++)
	{
		setBuzzer_Tone(pgm_read_word_near(&RAngwomendangqishuangjiang[j][0]), pgm_read_word_near(&RAngwomendangqishuangjiang[j][1]));	
	}
}

void YahBoom_Plugkit_Buzzer::xinnianhao()
{
	int j;
	for(j=0;j<30;j++)
	{
		setBuzzer_Tone(pgm_read_word_near(&XInnianhao[j][0]), pgm_read_word_near(&XInnianhao[j][1]));	
	}
}

void YahBoom_Plugkit_Buzzer::xiaoxingxing()
{
	int j;
	for(j=0;j<42;j++)
	{
		setBuzzer_Tone(pgm_read_word_near(&XIaoxingxing[j][0]), pgm_read_word_near(&XIaoxingxing[j][1]));	
	}
}

void YahBoom_Plugkit_Buzzer::liangzhilaohu()
{
	int j;
	for(j=0;j<32;j++)
	{
		setBuzzer_Tone(pgm_read_word_near(&LIangzhilaohu[j][0]), pgm_read_word_near(&LIangzhilaohu[j][1]));	
	}
}

void YahBoom_Plugkit_Buzzer::music_Play(uint8_t v_song, uint8_t v_repeat)
{
	switch(v_song)
	{ 
		case enBirthday:
			{
				do
				{
					birthday();
				}
				while(v_repeat-1);					
				break;
			}
		case Childhood:
			{
				do
				{
					childhood();
				}
				while(v_repeat-1);					
				break;
			}
			case Fenshuajiang:
			 {
				do
				{
					fenshuajiang();
				}
				while(v_repeat-1);					
				break;
			}
		case Wanghouyusheng:
		    {
				do
				{
					wanghouyusheng();
				}
				while(v_repeat-1);					
				break;
			}	
		case Huanlesong:
		    {
				do
				{
					huanlesong();
				}
				while(v_repeat-1);					
				break;
			}
		case Yuemayangbian:
			{
				do
				{
					yuemayangbian();
				}
				while(v_repeat-1);					
				break;
			}
		case Guangdongaiqinggushi:
			{
				do
				{
					guangdongaiqinggushi();
				}
				while(v_repeat-1);					
				break;
			}
		case Shishangzhiyoumamahao:
			{
				do
				{
					shishangzhiyoumamahao();
				}
				while(v_repeat-1);					
				break;
			}
		case Rangwomendangqishuangjiang:
			{
				do
				{
					rangwomendangqishuangjiang();
				}
				while(v_repeat-1);					
				break;
			}
			
		case Xinnianhao:
			{
				do
				{
					xinnianhao();
				}
				while(v_repeat-1);					
				break;
			}
		case Xiaoxingxing:
			{
				do
				{
					xiaoxingxing();
				}
				while(v_repeat-1);					
				break;
			}
		case Liangzhilaohu:
		    {
				do
				{
					liangzhilaohu();
				}
				while(v_repeat-1);					
				break;
			}
			
	}
		
}


/*********************************************************************/
/*按键模块*/
/******************************************************************/
YahBoom_Plugkit_Button::YahBoom_Plugkit_Button(byte pin)
{
	pinName = pin;
}

YahBoom_Plugkit_Button::~YahBoom_Plugkit_Button()
{
} 

bool YahBoom_Plugkit_Button::Get_Button_State()
{
	int val ;
	pinMode(pinName, INPUT_PULLUP);
	val = digitalRead(pinName);
	if(val == 0)
	{
		return true;
	}
	else
		return false;
}

/*********************************************************************/
/*电位器模块*/
/******************************************************************/
YahBoom_Plugkit_Potentiometer::YahBoom_Plugkit_Potentiometer(byte pin)
{
	pinName = pin;
}

YahBoom_Plugkit_Potentiometer::~YahBoom_Plugkit_Potentiometer()
{
}
 
void YahBoom_Plugkit_Potentiometer::YahBoom_Plugkit_Potentiometer_Init()
{
	pinMode(pinName, INPUT);
}

int YahBoom_Plugkit_Potentiometer::Get_Potentiometer_value()
{
	int val = 0;
	val = analogRead(pinName);
	return val;	
}

/*********************************************************************/
/*摇杆模块*/
/******************************************************************/
YahBoom_Plugkit_Rocker::YahBoom_Plugkit_Rocker(byte pin)
{
	pinName = pin;
}

YahBoom_Plugkit_Rocker::~YahBoom_Plugkit_Rocker()
{

} 

void YahBoom_Plugkit_Rocker::YahBoom_Plugkit_Rocker_Init()
{
	pinMode(pinName, INPUT);
}

int YahBoom_Plugkit_Rocker::Get_Rocker_State()
{
	int val = 0;
	val = analogRead(pinName);
	return val;
}

/*********************************************************************/
/*电机小风扇*/
/******************************************************************/
YahBoom_Plugkit_FAN::YahBoom_Plugkit_FAN(byte pin)   //构造函数 
{ 
	pinName = pin;
}

YahBoom_Plugkit_FAN::~YahBoom_Plugkit_FAN()
{
	
} 

void YahBoom_Plugkit_FAN::YahBoom_Plugkit_FAN_Init()
{
	pinMode(pinName, OUTPUT);
}

void YahBoom_Plugkit_FAN::SetFanSpeed(int speed)
{
	analogWrite(pinName, speed);
}



/*********************************************************************/
/*舵机*/
/******************************************************************/
YahBoom_Plugkit_Servo::YahBoom_Plugkit_Servo(byte pin)   //构造函数 
{ 
	pinName = pin;
}

YahBoom_Plugkit_Servo::~YahBoom_Plugkit_Servo()
{

} 

void YahBoom_Plugkit_Servo::YahBoom_Plugkit_Servo_Init()
{
	myservo.attach(pinName);
}

void YahBoom_Plugkit_Servo::SetServoAngle(int ServoPos)
{
	myservo.write(ServoPos);
}

void YahBoom_Plugkit_Servo::ServoGearRotating(int pos1, int pos2, int time)
{
	if(pos1 < pos2)
	{
		//舵机正转,转动角度pos2-pos1，每次延时time ms
		for (pos1; pos1 < pos2; pos1++)
		{
			myservo.write(pos1);
			delay(time);
		}
	}
	else
	{
		//舵机反转,转动角度pos1-pos2，每次延时time ms
		for (pos1; pos1 > pos2; pos1--)
		{
			myservo.write(pos1);
			delay(time);
		}
	}
}


/*********************************************************************/
/*OLED*/
/******************************************************************/
YahBoom_Plugkit_Oled::YahBoom_Plugkit_Oled()   //构造函数 
{ 

}

YahBoom_Plugkit_Oled::~YahBoom_Plugkit_Oled()
{

} 

void YahBoom_Plugkit_Oled::YahBoom_Plugkit_Oled_Init()
{
	// by default, we'll generate the high voltage from the 3.3v line internally! (neat!)
	display.begin(SSD1306_SWITCHCAPVCC, 0x3C); // initialize with the I2C addr 0x3C (for the 128x32)
	// init done
	display.display(); // show splashscreen
	delay(2000);
	//display.clearDisplay(); // clears the screen and buffer

	// delay(1000);
}

//之前的
// void YahBoom_Plugkit_Oled::YahBoom_Plugkit_Oled_clear()
// {
	// display.clearDisplay();
	// display.display(); 
// }

// 现在的
void YahBoom_Plugkit_Oled::YahBoom_Plugkit_Oled_clear()
{
	display.clearDisplay();
}

void YahBoom_Plugkit_Oled::YahBoom_Plugkit_Oled_display()
{
	display.display(); 
}

void YahBoom_Plugkit_Oled::YahBoom_Plugkit_Oled_drawPixel(uint8_t x,uint8_t y)
{
	display.drawPixel(x, y, WHITE); 
}

void YahBoom_Plugkit_Oled::YahBoom_Plugkit_Oled_drawLine(uint8_t x,uint8_t y,uint8_t x1,uint8_t y1)
{
	display.drawLine(x, y, x1, y1, WHITE); 
}

void YahBoom_Plugkit_Oled::YahBoom_Plugkit_Oled_character(int fontsize, int character_x, int character_y , const char *str )//x，y的大小限制，打印字符串
{
	display.setTextSize(fontsize);
	display.setTextColor(WHITE);
	display.setCursor(character_x, character_y);
	display.println(str);
}

void YahBoom_Plugkit_Oled::YahBoom_Plugkit_Oled_number(int fontsize, int number_x , int number_y , unsigned long int num)//打印数字，让森哥限制位置大小
{
	display.setTextSize(fontsize);
	display.setTextColor(WHITE);
	display.setCursor(number_x, number_y);
	display.println(num);
}

//以下是定义的需要显示的静态图案
void YahBoom_Plugkit_Oled::testdrawcircle(uint16_t x, uint16_t y) //空心圆
{  
	display.drawCircle(x, y, 15, WHITE);
}

void YahBoom_Plugkit_Oled::testdrawtriangle() //空心三角形
{
	display.drawTriangle(30,0,15,30,45,30,WHITE);
}

void YahBoom_Plugkit_Oled::testdrawrect(uint16_t x, uint16_t y) //空心矩形
{  
	display.drawRect(x, y, 64, 24, WHITE);
}

void YahBoom_Plugkit_Oled::testdrawroundrect(uint16_t x, uint16_t y) //空心圆矩形
{
	display.drawRoundRect(x,y,64,24,7,WHITE);
}

void YahBoom_Plugkit_Oled::testdrawheart(uint16_t x, uint16_t y) //心形
{
	display.drawBitmap(x, y, heart1, 35, 28, 1);
}	

void YahBoom_Plugkit_Oled::testdrawstar(uint16_t x, uint16_t y) //星形
{
    display.drawBitmap(x, y, star1, 36, 29, 1); 
}

void YahBoom_Plugkit_Oled::testdrawright(uint16_t x, uint16_t y)//正确
{
    display.drawBitmap(x, y, right1, 44, 31, 1);
}

void YahBoom_Plugkit_Oled::testdrawerror(uint16_t x, uint16_t y)//错误
{
    display.drawBitmap(x, y, error1, 36, 32, 1); 
}

void YahBoom_Plugkit_Oled::testdrawhouse(uint16_t x, uint16_t y)//房子
{
    display.drawBitmap(x, y, house1, 75, 32, 1);
}

void YahBoom_Plugkit_Oled::testdrawboat(uint16_t x, uint16_t y)//小船
{
    display.drawBitmap(x, y, boat1, 101, 32, 1);
}

void YahBoom_Plugkit_Oled::testdrawumbrella(uint16_t x, uint16_t y)//雨伞
{
    display.drawBitmap(x, y, umbrella1, 57, 32, 1);
}

void YahBoom_Plugkit_Oled::testdrawsmile(uint16_t x, uint16_t y)//笑脸
{
    display.drawBitmap(x, y, smile1, 34, 30, 1); 
}

void YahBoom_Plugkit_Oled::testdrawcry(uint16_t x, uint16_t y)//哭脸
{
    display.drawBitmap(x, y, cry1, 34, 30, 1); 
}

void YahBoom_Plugkit_Oled::testdrawnote(uint16_t x, uint16_t y)//音符
{
    display.drawBitmap(x, y, note1, 35, 32, 1);
}

void YahBoom_Plugkit_Oled::testdrawxhr(uint16_t x, uint16_t y)//小黄人
{
    display.drawBitmap(x, y, xhr1, 41, 32, 1);
}

void YahBoom_Plugkit_Oled::testdrawpkq(uint16_t x, uint16_t y)//皮卡丘
{
    display.drawBitmap(x, y, pkq1, 32, 32, 1); 
}

void YahBoom_Plugkit_Oled::testdrawhmbb(uint16_t x, uint16_t y)//海绵宝宝
{
    display.drawBitmap(x, y, hmbb1, 44, 32, 1); 
}

void YahBoom_Plugkit_Oled::testdrawxzpq(uint16_t x, uint16_t y)//小猪佩奇
{
    display.drawBitmap(x, y, xzpq1, 25, 32, 1); 
}



//选择显示静态图案
void YahBoom_Plugkit_Oled::YahBoom_Plugkit_Oled_staticPicture(uint16_t x1, uint16_t y1, uint8_t v_spic)
{
	switch(v_spic)
	{ 
		case encircle:
			{
				testdrawcircle(x1, y1);
				break;
			}
		case triangle:
			{
				testdrawtriangle();
				break;
			}
		case rect:
			{
				testdrawrect(x1, y1);				
				break;
			}
		case roundrect:
			{
				testdrawroundrect(x1, y1);				
				break;
			}
		case heart:
			{
				testdrawheart(x1, y1);					
				break;
			}
		case star:
			{
				testdrawstar(x1, y1);					
				break;
			}	
		case right2:
			{
				testdrawright(x1, y1);					
				break;
			}	
		case error:
			{
				testdrawerror(x1, y1);					
				break;
			}
		case house:
			{
				testdrawhouse(x1, y1);					
				break;
			}
		case boat:
			{
				testdrawboat(x1, y1);					
				break;
			}	
		case umbrella:
			{
				testdrawumbrella(x1, y1);					
				break;
			}	
		case smile:
			{
				testdrawsmile(x1, y1);					
				break;
			}
		case cry:
			{
				testdrawcry(x1, y1);					
				break;
			}
		case note:
			{
				testdrawnote(x1, y1);					
				break;
			}
		case xhr:
			{
				testdrawxhr(x1, y1);					
				break;
			}	
		case pkq:
			{
				testdrawpkq(x1, y1);					
				break;
			}	
		case hmbb:
			{
				testdrawhmbb(x1, y1);					
				break;
			}	
		case xzpq:
			{
				testdrawxzpq(x1, y1);					
				break;
			}			
	}
}

void YahBoom_Plugkit_Oled::testfillrect()//填充圆形
{
	display.clearDisplay();
	for (int16_t i=0; i<display.height(); i+=2) 
	{
		display.drawCircle(display.width()/2, display.height()/2, i, WHITE);
		display.display();
	}
	delay(2000);//延时两秒
}

void YahBoom_Plugkit_Oled::testfilltriangle()//填充三角形
{
	display.clearDisplay();
	for (int16_t i=0; i<min(display.width(),display.height())/2; i+=5) 
	{
		display.drawTriangle(display.width()/2, display.height()/2-i,
						 display.width()/2-i, display.height()/2+i,
						 display.width()/2+i, display.height()/2+i, WHITE);
		display.display();
	}
	delay(2000);
}

void YahBoom_Plugkit_Oled::testfillroundrect() //填充矩形
{
	uint8_t color = 1;
	display.clearDisplay();
	for (int16_t i=0; i<display.height()/2; i+=3) 
	{
		// alternate colors
		display.fillRect(i, i, display.width()-i*2, display.height()-i*2, color%2);
		display.display();
		color++;
	}
	delay(2000);
	display.clearDisplay();
	for (int16_t i=0; i<display.height()/2; i+=2)
	{
		display.drawRect(i, i, display.width()-2*i, display.height()-2*i, WHITE);
		display.display();
	}	
	delay(2000);
}
   

void YahBoom_Plugkit_Oled::testdrawbitmap(const uint8_t *bitmap, uint8_t w, uint8_t h) //微型图标函数
{
	uint8_t icons[NUMFLAKES][3];
	srandom(666);     // whatever seed

	// initialize
	for (uint8_t f=0; f< NUMFLAKES; f++)
	{
		icons[f][XPOS] = random() % display.width();
		icons[f][YPOS] = 0;
		icons[f][DELTAY] = random() % 5 + 1;
	}

	while (1)
	{
		// draw each icon
		for (uint8_t f=0; f< NUMFLAKES; f++) 
		{
			display.drawBitmap(icons[f][XPOS], icons[f][YPOS], bitmap, w, h, WHITE);
		}
		display.display();
		delay(200);

		// then erase it + move it
		for (uint8_t f=0; f< NUMFLAKES; f++)
		{
			display.drawBitmap(icons[f][XPOS], icons[f][YPOS],  bitmap, w, h, BLACK);
			// move it
			icons[f][YPOS] += icons[f][DELTAY];
			// if its gone, reinit
			if (icons[f][YPOS] > display.height())
			{
				icons[f][XPOS] = random() % display.width();
				icons[f][YPOS] = 0;
				icons[f][DELTAY] = random() % 5 + 1;
			}
		}
	}
}

void YahBoom_Plugkit_Oled::harichord(int frame)//几何动画
{
  display.clearDisplay();
  int n = 7;
  int r = frame * 64 / nFrames;
  float rot = frame * 2*PI / nFrames;
  for (int i=0; i<(n-1); i++)
  {
    float a = rot + i * 2*PI / n;
    int x1 = 64 + cos(a) * r;
    int y1 = 32 + sin(a) * r;
    for (int j=i+1; j<n; j++)
    {
      a = rot + j * 2*PI / n;
      int x2 = 64 + cos(a) * r;
      int y2 = 32 + sin(a) * r;
      display.drawLine(x1,y1, x2,y2, WHITE);
    }
  }
  display.display();
}

void YahBoom_Plugkit_Oled::YahBoom_Plugkit_Oled_movePicture(uint8_t v_mode)  //显示动态图案
{
	switch(v_mode)
	{ 
		case enfillrect:
			{
				while(1)
				{
					testfillrect();
				}				
				break;
			}
		case filltriangle:
			{
				while(1)
				{
					testfilltriangle();
				}					
				break;
			}
		case fillroundrect:
			{
				while(1)
				{
					testfillroundrect();
				}					
				break;
			}
		case beatingheart:
			{
				while(1)
				{
					testdrawbitmap(Heart_16x16, 16, 16);//跳动的心
				}					
				break;
			}
		case babysbreath:
			{
				while(1)
				{
					testdrawbitmap(star_16x16, 16, 16);//满天星星
				}					
				break;
			}
		case geometryanimation:
			{
				while(1)
				{
					for (int frame=0; frame < nFrames; frame++)//几何动画
					{
						harichord(frame);
					}

					for (int frame=(nFrames-1); frame >= 0; frame--)
					{
						harichord(frame);
					}
				}					
				break;
			}			 
	}
}

void YahBoom_Plugkit_Oled::scrollright(int time) //向左滚动
{
	display.startscrollright(0x00, 0x0F);
	delay(time);
	display.stopscroll();
	display.clearDisplay();
}

void YahBoom_Plugkit_Oled::scrollleft(int time) //向右滚动
{
	display.startscrollleft(0x00, 0x0F);
	delay(time);
	display.stopscroll(); 
	display.clearDisplay();
}

void YahBoom_Plugkit_Oled::scrolldiagright(int time) //向左上滚动
{
	display.startscrolldiagright(0x00, 0x0F);
	delay(time);
	display.stopscroll();
	display.clearDisplay();
}

void YahBoom_Plugkit_Oled::scrolldiagleft(int time) //向右上滚动
{
	display.startscrolldiagleft(0x00, 0x0F);
	delay(time);
	display.stopscroll();
	display.clearDisplay();
	
}

void YahBoom_Plugkit_Oled::YahBoom_Plugkit_Oled_moveStr(const char *str, uint8_t v_mode, int t)  //滚动显示字符串
{
	display.clearDisplay();
	YahBoom_Plugkit_Oled_character(1, 10, 0, str);
	display.display();
	switch(v_mode)
	{ 
		case enstatic:
			{
				break;
			}
		case left:
			{
				scrollleft(t);
				break;
			}
		case right:
			{
				scrollright(t);
				break;
			}
		case diagleft:
			{
				scrolldiagleft(t);
				break;
			}
		case diagright:
			{
				scrolldiagright(t);		
				break;
			}
	}
}

void YahBoom_Plugkit_Oled::YahBoom_Plugkit_Oled_dynamicPicture(uint8_t v_spic, uint8_t v_mode, int t)  //滚动显示图案
{
	display.clearDisplay();
	if(v_spic == 1)
	{
		YahBoom_Plugkit_Oled_staticPicture(16, 16, v_spic);
	}
	else
	{
		YahBoom_Plugkit_Oled_staticPicture(1, 1, v_spic);
	}
	display.display();
	switch(v_mode)
	{ 
		case enstatic:
			{
				break;
			}
		case left:
			{
				scrollleft(t);
				break;
			}
		case right:
			{
				scrollright(t);
				break;
			}
		case diagleft:
			{
				scrolldiagleft(t);
				break;
			}
		case diagright:
			{
				scrolldiagright(t);		
				break;
			}
	}
}

void YahBoom_Plugkit_Oled::YahBoom_Plugkit_Oled_Sensordata(int fontsize, int character_x, int character_y, const char *str, int sensordata)//x，y的大小限制，打印字符串
{
	display.setTextSize(fontsize);
	display.setTextColor(WHITE);
	display.setCursor(character_x, character_y);
	display.println(str);
	display.println(sensordata);
}
/*********************************************************************/
/*红外接收*/
/******************************************************************/
//参考OMIBOX
//红外接收扩展板上面固定12号引脚
YahBoom_Plugkit_IRrecv::YahBoom_Plugkit_IRrecv(byte v_pinname)
{
	last = millis();
	receive_number=0;
	pinname = v_pinname;
}

YahBoom_Plugkit_IRrecv::~YahBoom_Plugkit_IRrecv()
{
	
}

void YahBoom_Plugkit_IRrecv::YahBoom_Plugkit_IRrecv_Init()
{

	irrecv.enableIRIn(); // 初始化红外解码
	pinMode(pinname, INPUT_PULLUP); 
}
int YahBoom_Plugkit_IRrecv::IR_Deal()
{
	//int receive_number=0;
	if (irrecv.decode(&results))
	{
		// Serial.println(results.value,HEX);
		//根据不同值来执行不同操作
		//  00FF00FF  开关
		//  00FF40BF  Light
		//  00FF30CF   +
		//  00FF708F   -
		//  00FFA05F     beep
		//  00FF807F     前进
		//  00FF20DF     左转
		//  00FF00FF     停止
		//  00FF609F     右转
		//  00FF906F     后退
		//  00FF10EF     左旋
		//  00FF50AF     右旋
		//  00FFB04F     0
		//  00FF08F7     1
		//  00FF8877     2
		//  00FF48B7     3
		//  00FF28D7     4
		//  00FFA857     5
		//  00FF6897     6
		//  00FF18E7     7
		//  00FF9867     8
		//  00FF58A7     9    		
		switch (results.value)
		{	
			case 0X00FF00FF: receive_number = 1;  break;  //enSTOP  开关/停止
			case 0X00FF40BF: receive_number = 2;  break;  //enLIGHT Light
			case 0X00FFA05F: receive_number = 3;  break;  //enBEEP  beep
			case 0X00FF807F: receive_number = 4;  break;  //enRUN   前进
			case 0X00FF906F: receive_number = 5;  break;  //enBACK  后退
			case 0X00FF20DF: receive_number = 6;  break;  //enLEFT  左转
			case 0X00FF609F: receive_number = 7;  break;  //enRIGHT 右转
			case 0X00FF10EF: receive_number = 8;  break;  //enTLEFT 左旋
			case 0X00FF50AF: receive_number = 9;  break;  //enTRIGHT右旋
			case 0X00FF30CF: receive_number = 10;  break; //enPLUS  +
			case 0X00FF708F: receive_number = 11;  break; //enLESS  -
			case 0X00FFB04F: receive_number = 12;  break; //en0
			case 0X00FF08F7: receive_number = 13;  break; //en1
			case 0X00FF8877: receive_number = 14;  break; //en2
			case 0X00FF48B7: receive_number = 15;  break; //en3
			case 0X00FF28D7: receive_number = 16;  break; //en4
			case 0X00FFA857: receive_number = 17;  break; //en5
			case 0X00FF6897: receive_number = 18;  break; //en6
			case 0X00FF18E7: receive_number = 19;  break; //en7
			case 0X00FF9867: receive_number = 20;  break; //en8
			case 0X00FF58A7: receive_number = 21;  break; //en9	
			
			//case 0xFFFFFFFF: receive_number = last_receive_number;	 break;
			default: break;
		}
		// 
		//last_receive_number = receive_number;
		last = millis();
		irrecv.resume(); // 接收下一个编码
		//Serial.println(receive_number,DEC);
		// return receive_number; 
		//last_receive_number = receive_number;
	}

	/*if(receive_number==num)
	{
		last_receive_number = receive_number;
		//receive_number = 0;
		return 1;
	}

	else
	{
		last_receive_number = 0;
		return 0; 
	}*/
	else if (millis() - last > 120)
	{
		receive_number = 0;
		last = millis();
		//	 return 0;
	}
	return receive_number; 
   
}

/*********************************************************************/
/*声音传感器*/
/******************************************************************/
//声音 光敏 霍尔参考OMIBOX声音传感器
//声音光敏霍尔传感器扩展板上只预留（GND A0 A1 5V）（GND A1 A2 5V）（GND A2 A3 5V）这三种接口
//通过防呆线连接的话只能选A1 A2 A3三个模拟引脚
YahBoom_Plugkit_VoiceSensor::YahBoom_Plugkit_VoiceSensor(byte pin)
{
	pinName = pin;
}

YahBoom_Plugkit_VoiceSensor::~YahBoom_Plugkit_VoiceSensor()
{
	 
} 

void YahBoom_Plugkit_VoiceSensor::YahBoom_Plugkit_VoiceSensor_Init()
{
	pinMode(pinName, INPUT);
}

int YahBoom_Plugkit_VoiceSensor::get_VoiceSensor()
{
	int state = 0;
	state = analogRead(pinName);
	return state;	
}

/*********************************************************************/
/*光敏传感器*/
/******************************************************************/
YahBoom_Plugkit_LightSensor::YahBoom_Plugkit_LightSensor(byte pin)
{
	pinName = pin;
}

YahBoom_Plugkit_LightSensor::~YahBoom_Plugkit_LightSensor()
{
	 
} 

void YahBoom_Plugkit_LightSensor::YahBoom_Plugkit_LightSensor_Init()
{
	pinMode(pinName, INPUT);
}

int YahBoom_Plugkit_LightSensor::get_LightSensor()
{
	int state = 0;
	state = analogRead(pinName);
	return state;	
}

/*********************************************************************/
/*霍尔传感器*/
/******************************************************************/
YahBoom_Plugkit_MagnetSensor::YahBoom_Plugkit_MagnetSensor(byte pin)
{
	pinName = pin;
}

YahBoom_Plugkit_MagnetSensor::~YahBoom_Plugkit_MagnetSensor()
{
	 
} 

void YahBoom_Plugkit_MagnetSensor::YahBoom_Plugkit_MagnetSensor_Init()
{
	pinMode(pinName, INPUT);
}

int YahBoom_Plugkit_MagnetSensor::get_MagnetSensor()
{
	int state = 0;
	state = analogRead(pinName);
	return state;	
}

/*********************************************************************/
/*震动传感器*/
/******************************************************************/
YahBoom_Plugkit_ShakeSensor::YahBoom_Plugkit_ShakeSensor(byte pin)
{
	pinName = pin;
}

YahBoom_Plugkit_ShakeSensor::~YahBoom_Plugkit_ShakeSensor()
{
	 
} 

void YahBoom_Plugkit_ShakeSensor::YahBoom_Plugkit_ShakeSensor_Init()
{
	pinMode(pinName, INPUT);
}

bool YahBoom_Plugkit_ShakeSensor::get_ShakeSensor()
{
	if(digitalRead(pinName) == 0)
	{              
		return true;
	}  
	else 
		return false;      
}



/*********************************************************************/
/*颜色识别传感器*/
/******************************************************************/
//参考OMIBOX
YahBoom_Plugkit_Color::YahBoom_Plugkit_Color()
{
		
}
YahBoom_Plugkit_Color::~YahBoom_Plugkit_Color()
{
		
}
void YahBoom_Plugkit_Color::RGB_Config()
{
	uint8_t W_ADDR;

	//复位寄存器，200ms积分时间，CRGB通道全部开启
	Wire.beginTransmission(ADDR);  //发送Device地址
	Wire.write(ControlReg_Addr);   
	Wire.write(0x06); 
	Wire.endTransmission();        //发送结速信号

	Wire.beginTransmission(ADDR);  //发送Device地址
	Wire.write(0x04);   
	Wire.write(0x41);              //16bit 50ms
	Wire.endTransmission();        //发送结速信号

	Wire.beginTransmission(ADDR);  //发送Device地址
	Wire.write(0x05);   
	Wire.write(0x01); 
	Wire.endTransmission();        //发送结速信号
}

void YahBoom_Plugkit_Color::YahBoom_Plugkit_Color_Init()
{

	Wire.begin();
  	Wire.setClock(100000);
  	RGB_Config();
}

/* 第一种写法 */
bool YahBoom_Plugkit_Color::YahBoom_Plugkit_Identify_Color(byte color)
{
	int nowcolor = 0;
	int index = 0;
	char ColorData[6] = {0};
	digitalWrite(4,1);
	//红色

	Wire.beginTransmission(ADDR);  //发送Device地址
	Wire.write(0x10);  
	Wire.endTransmission();     //发送结束信号
	Wire.beginTransmission(ADDR);  //发送Device地址
	Wire.requestFrom(ADDR, 2);    // request 1 bytes from slave device #2
	while(Wire.available())    // slave may send less than requested
	{ 
	char ff = Wire.read();    // receive a byte as character
	ColorData[index] = ff;
	index++;

	}
	Wire.endTransmission();     //发送结束信号

	//绿色
	Wire.beginTransmission(ADDR);  //发送Device地址
	Wire.write(0x0D);  
	Wire.endTransmission();     //发送结束信号
	Wire.beginTransmission(ADDR);  //发送Device地址
	Wire.requestFrom(ADDR, 2);    // request 1 bytes from slave device #2
	while(Wire.available())    // slave may send less than requested
	{ 
	char ff = Wire.read();    // receive a byte as character
	ColorData[index] = ff;
	index++;
	//   printf("Green:%x\n", ff);  
	}
	Wire.endTransmission();     //发送结束信号

	//蓝色
	Wire.beginTransmission(ADDR);  //发送Device地址
	Wire.write(0x13);  
	Wire.endTransmission();     //发送结束信号
	Wire.beginTransmission(ADDR);  //发送Device地址
	Wire.requestFrom(ADDR, 2);    // request 1 bytes from slave device #2
	while(Wire.available())    // slave may send less than requested
	{ 
	char ff = Wire.read();    // receive a byte as character
	ColorData[index] = ff;
	index++;
	//printf("Blue:%x\n", ff);  
	}
	Wire.endTransmission();     //发送结束信号
	//delay(500);  
	// printf("R:%x,%x, G:%x,%x, B:%x, %x,\n",ColorData[0], ColorData[1], ColorData[2], ColorData[3], ColorData[4], ColorData[5]);

	Red = ((int)(ColorData[1]&0xff) << 8 | (ColorData[0]&0xff));//2.06
	Green = ((int)(ColorData[3]&0xff) << 8 | (ColorData[2]&0xff));
	Blue = ((int)(ColorData[5]&0xff) << 8 | (ColorData[4]&0xff));//1.19

	// printf("R:%d, G:%d, B:%d\n", Red, Green, Blue);
	// Serial.println("R:%d, G:%d, B:%d\n", Red, Green, Blue);
	// Serial.println(Red,DEC);
	// Serial.println(Green,DEC);
	// Serial.println(Blue,DEC);
	// Serial.println(0);

	if(Red >= 1100 && Red <= 2500 && Green >= 900 && Green <= 2100 && Blue >= 100 && Blue <= 1000)//红色
	{
		Red = 255;
		Green = 0;
		Blue = 0;
		nowcolor = 1;
	}

	else if(Red >= 450 && Red <= 1200 && Green >= 800 && Green <= 2000 && Blue >= 500 && Blue <= 1100) //绿色

	{
		Red = 0;
		Green = 255;
		Blue = 0;
		nowcolor = 2;
	}

	else if(Red >= 400 && Red <= 1200 && Green >= 1500 && Green <= 3000 && Blue >= 1100 && Blue <= 3000)//蓝色
	{
		Red = 0;
		Green = 0;
		Blue = 255;
		nowcolor = 3;
	}

	else if(Red >= 2500 && Green >= 5000 && Blue >= 2600 ) //白色
	{
		Red = 0;
		Green = 0;
		Blue = 0;
		nowcolor = 4;
	}

	if(nowcolor == color)
		return true;
	else
		return false;
  	
}

/* 第二种写法 */
//输出颜色识别传感器检测到的值
void YahBoom_Plugkit_Color::get_ColorSensor()
{
	int index = 0;
    char ColorData[6] = {0};
	digitalWrite(4,1);
	//红色
	Wire.beginTransmission(ADDR);   //发送Device地址
	Wire.write(0x10);  
	Wire.endTransmission();         //发送结束信号
	Wire.beginTransmission(ADDR);   //发送Device地址
	Wire.requestFrom(ADDR, 2);      // request 1 bytes from slave device #2
	while(Wire.available())         // slave may send less than requested
	{ 
		char ff = Wire.read();      // receive a byte as character
		ColorData[index] = ff;
		index++;
    }
	Wire.endTransmission();     //发送结束信号
	
	//绿色
	Wire.beginTransmission(ADDR);   //发送Device地址
	Wire.write(0x0D);  
	Wire.endTransmission();         //发送结束信号
	Wire.beginTransmission(ADDR);   //发送Device地址
	Wire.requestFrom(ADDR, 2);      // request 1 bytes from slave device #2
	while(Wire.available())         // slave may send less than requested
	{ 
		char ff = Wire.read();      // receive a byte as character
		ColorData[index] = ff; 
		index++;
		//printf("Green:%x\n", ff);  
	}
	Wire.endTransmission();         //发送结束信号
	
	//蓝色
	Wire.beginTransmission(ADDR);     //发送Device地址
	Wire.write(0x13);  
	Wire.endTransmission();          //发送结束信号
	Wire.beginTransmission(ADDR);    //发送Device地址
	Wire.requestFrom(ADDR, 2);       // request 1 bytes from slave device #2
	while(Wire.available())          // slave may send less than requested
	{ 
		char ff = Wire.read();          // receive a byte as character
		ColorData[index] = ff;
		index++;
		//printf("Blue:%x\n", ff);  
	}
	Wire.endTransmission();     //发送结束信号
	//delay(500);  

	Red = ((unsigned int)(ColorData[1]&0xff) << 8 | (ColorData[0]&0xff));//2.06
	Green = ((unsigned int)(ColorData[3]&0xff) << 8 | (ColorData[2]&0xff));
	Blue = ((unsigned int)(ColorData[5]&0xff) << 8 | (ColorData[4]&0xff));
	
	
    if(Red > 4500) Red = 4500;
	if(Green > 7600) Green = 7600;
	if(Blue > 4600) Blue = 4600;
	val_R = map(Red, 0, 4500, 0, 255);
	val_B = map(Blue, 0, 4600, 0, 255);
    val_G = map(Green, 0, 7600, 0, 255);
		
	if (val_R > val_G && val_R > val_B)  
	{ 		
		val_R = 255;
		val_G /= 2;
		val_B /= 2;
		
	} 
	else if (val_G > val_R && val_G > val_B) 	 	
	{

		val_G = 255;
		val_R /= 2;
		val_B /= 2;
	} 
	else if (val_B > val_R && val_B >  val_G) 	 		
	{
		val_B = 255;
		val_R /=2;
		val_G /= 2;
    }

  
}  

//输出颜色识别传感器检测到的Red的值
int YahBoom_Plugkit_Color::ReturnRedValue()
{
	get_ColorSensor();
	return val_R;
}

//输出颜色识别传感器检测到的Green的值
int YahBoom_Plugkit_Color::ReturnGreenValue()
{
	get_ColorSensor();
	return val_G;
}

//输出颜色识别传感器检测到的Blue的值
int YahBoom_Plugkit_Color::ReturnBlueValue()
{
	get_ColorSensor();
	return val_B;
}

/*********************************************************************/
/*温湿度传感器*/
/******************************************************************/
//扩展板上预留了（GND 2 5V）这一组接口
YahBoom_Plugkit_HumitureSensor::YahBoom_Plugkit_HumitureSensor(byte pin)	 //构造函数
{
	pinName = pin;
}
YahBoom_Plugkit_HumitureSensor::~YahBoom_Plugkit_HumitureSensor() 
{
	
} 
void YahBoom_Plugkit_HumitureSensor::YahBoom_Plugkit_HumitureSensor_Init()
{
	pinMode(pinName, INPUT);
}

float YahBoom_Plugkit_HumitureSensor::get_temperature()
{
	chk = DHT11.read(pinName);                 //将读取到的值赋给chk
	tem=(float)DHT11.temperature;               //将温度值赋值给tem
	return tem;
}

float YahBoom_Plugkit_HumitureSensor::get_humidity()
{
	chk = DHT11.read(pinName);                 //将读取到的值赋给chk
	hum=(float)DHT11.humidity;                   //将湿度值赋给hum
	return hum;
}

/*********************************************************************/
/*超声波传感器*/
/******************************************************************/
YahBoom_Plugkit_UltrasonicSensor::YahBoom_Plugkit_UltrasonicSensor(byte pin1, byte pin2)	 //构造函数
{
	Trig = pin1;
	Echo = pin2;
}
YahBoom_Plugkit_UltrasonicSensor::~YahBoom_Plugkit_UltrasonicSensor() 
{
	
} 	
void YahBoom_Plugkit_UltrasonicSensor::YahBoom_Plugkit_UltrasonicSensor_Init() 
{
	pinMode(Trig, OUTPUT);
	pinMode(Echo, INPUT); 
} 

int YahBoom_Plugkit_UltrasonicSensor::get_UltrasonicSensor() 
{
	digitalWrite(Trig, LOW);   // 给触发脚低电平2μs
	delayMicroseconds(2);
	digitalWrite(Trig, HIGH);  // 给触发脚高电平10μs，这里至少是10μs
	delayMicroseconds(10);
	digitalWrite(Trig, LOW);   // 持续给触发脚低电平
	float Fdistance = pulseIn(Echo, HIGH);  // 读取高电平时间(单位：微秒)
	Fdistance= Fdistance/58;       //为什么除以58等于厘米，  Y米=（X秒*344）/2
	// X秒=（ 2*Y米）/344 ==》X秒=0.0058*Y米 ==》厘米=微秒/58
	Distance = Fdistance;
	return Distance;
} 	